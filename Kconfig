## Kconfig
```kconfig
config CW1200
	tristate "CW1200 WLAN support"
	depends on MAC80211 && CFG80211
	help
	  This is a driver for the ST-E CW1100 & CW1200 WLAN chipsets.
	  This option just enables the driver core, see below for
	  specific bus support.

if CW1200

config CW1200_WLAN_SDIO
	tristate "Support SDIO platforms"
	depends on MMC
	help
	  Enable support for the CW1200 connected via an SDIO bus.
	  By default this driver only supports the Sagrad SG901-1091/1098 EVK
	  and similar designs that utilize a hardware reset circuit. To
	  support different CW1200 SDIO designs you will need to override
	  the default platform data by calling cw1200_sdio_set_platform_data()
	  in your board setup file.

config CW1200_SPI
       tristate "Support SPI platform"
       depends on SPI

choice 
       prompt "SPI platform subtype"
       depends on CW1200_SPI
       default CW1200_WLAN_SPI
       
config CW1200_WLAN_SPI
       tristate "Support SPI Linux default bus master"
       depends on CW1200_SPI
       help
         This enables support for the CW1200 via a SPI bus.

config CW1200_WLAN_SPI_NBS
       tristate "Support SPI NBS bus master (EXPERIMENTAL)"
       depends on CW1200_SPI
       help
         This enables support for the CW1200 via a SPI NBS bus.
endchoice

config CW1200_WSM_TRACE
	bool "Enable tracing of WSM commands."
	default N
	---help---
	  A debugging option to trace CW1200 chip commands sent before
	  a lock up.
endif
```
